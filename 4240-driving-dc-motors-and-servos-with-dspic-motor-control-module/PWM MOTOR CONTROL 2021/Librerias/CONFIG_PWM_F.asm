
_pwm_fast_init:

;CONFIG_PWM_F.c,3 :: 		void pwm_fast_init()
;CONFIG_PWM_F.c,9 :: 		TRISB12_bit=0;
	BCLR	TRISB12_bit, BitPos(TRISB12_bit+0)
;CONFIG_PWM_F.c,10 :: 		TRISB13_bit=0;
	BCLR	TRISB13_bit, BitPos(TRISB13_bit+0)
;CONFIG_PWM_F.c,11 :: 		TRISB14_bit=0;
	BCLR	TRISB14_bit, BitPos(TRISB14_bit+0)
;CONFIG_PWM_F.c,12 :: 		TRISB15_bit=0;
	BCLR	TRISB15_bit, BitPos(TRISB15_bit+0)
;CONFIG_PWM_F.c,14 :: 		P1TCON=0;  //limpia todos los bits
	CLR	P1TCON
;CONFIG_PWM_F.c,16 :: 		P1TPER=12499;  //carga el periodo;
	MOV	#12499, W0
	MOV	WREG, P1TPER
;CONFIG_PWM_F.c,18 :: 		P1TCONbits.PTEN=1; //Habilita el timer
	BSET	P1TCONbits, #15
;CONFIG_PWM_F.c,19 :: 		P1TCONbits.PTOPS=0B0000; //  POSTPRESCALADOR  DE SALIDA EN CERO   0-16  =0
	MOV	#lo_addr(P1TCONbits), W0
	MOV.B	[W0], W1
	MOV.B	#15, W0
	AND.B	W1, W0, W1
	MOV	#lo_addr(P1TCONbits), W0
	MOV.B	W1, [W0]
;CONFIG_PWM_F.c,22 :: 		P1TCONbits.PTCKPS=0B11; //  PREESCALSOR DE ENTRRADA  1  =64
	MOV	#lo_addr(P1TCONbits), W0
	MOV.B	[W0], W0
	IOR.B	W0, #12, W1
	MOV	#lo_addr(P1TCONbits), W0
	MOV.B	W1, [W0]
;CONFIG_PWM_F.c,25 :: 		P1TCONbits.PTMOD=0B00; //  OPERA EN MODO CONTINUO   CONTADOR ASCENDENTE
	MOV	#lo_addr(P1TCONbits), W0
	MOV.B	[W0], W1
	MOV.B	#252, W0
	AND.B	W1, W0, W1
	MOV	#lo_addr(P1TCONbits), W0
	MOV.B	W1, [W0]
;CONFIG_PWM_F.c,28 :: 		PWM1CON1=0;
	CLR	PWM1CON1
;CONFIG_PWM_F.c,30 :: 		PMOD1_bit=1;  //PWM1x1 EN MODO INDEPENDIENTE
	BSET	PMOD1_bit, BitPos(PMOD1_bit+0)
;CONFIG_PWM_F.c,31 :: 		PMOD2_bit=1; // PWM1x2 EN MODO INDEPENDIENTE
	BSET	PMOD2_bit, BitPos(PMOD2_bit+0)
;CONFIG_PWM_F.c,33 :: 		PEN1L_bit=1; // HABILITA SALIDA PWM1L1 COMO PWM
	BSET	PEN1L_bit, BitPos(PEN1L_bit+0)
;CONFIG_PWM_F.c,36 :: 		PEN2L_bit=1; // HABILITA SALIDA PWM1L2 COMO PWM
	BSET	PEN2L_bit, BitPos(PEN2L_bit+0)
;CONFIG_PWM_F.c,41 :: 		PWM1CON2=0;
	CLR	PWM1CON2
;CONFIG_PWM_F.c,42 :: 		PWM1CON2bits.IUE=1; // ACTUALIZA LOS CICLO UTIL DE INEMDIATO
	BSET.B	PWM1CON2bits, #2
;CONFIG_PWM_F.c,45 :: 		POVD1L_bit=1;
	BSET	POVD1L_bit, BitPos(POVD1L_bit+0)
;CONFIG_PWM_F.c,48 :: 		POVD2L_bit=1;
	BSET	POVD2L_bit, BitPos(POVD2L_bit+0)
;CONFIG_PWM_F.c,54 :: 		P1DC1=1249;
	MOV	#1249, W0
	MOV	WREG, P1DC1
;CONFIG_PWM_F.c,55 :: 		P1DC2=12449; //CICLO UTIL AL 50%
	MOV	#12449, W0
	MOV	WREG, P1DC2
;CONFIG_PWM_F.c,62 :: 		}
L_end_pwm_fast_init:
	RETURN
; end of _pwm_fast_init
