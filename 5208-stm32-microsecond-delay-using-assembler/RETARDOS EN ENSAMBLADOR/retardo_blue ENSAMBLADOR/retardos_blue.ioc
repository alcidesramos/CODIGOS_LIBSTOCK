# file: retardos_blue.ioc
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Mcu.Family=STM32F1
Mcu.Name=STM32F103C(8-B)Tx
Mcu.Package=LQFP48
NVIC.PriorityGroup=NVIC_PRIORITYGROUP_4
PB11.GPIO_Label=salida
PB11.Signal=GPIO_Output
PD0-OSC_IN.Mode=HSE-External-Oscillator
PD0-OSC_IN.Signal=RCC_OSC_IN
PD1-OSC_OUT.Mode=HSE-External-Oscillator
PD1-OSC_OUT.Signal=RCC_OSC_OUT
ProjectManager.HeapSize=0x200
ProjectManager.StackSize=0x400
ProjectManager.TargetToolchain=STM32CubeIDE
RCC.AHBFreq_Value=72000000
RCC.APB1CLKDivider=RCC_HCLK_DIV2
RCC.APB1Freq_Value=36000000
RCC.APB1TimFreq_Value=72000000
RCC.APB2Freq_Value=72000000
RCC.APB2TimFreq_Value=72000000
RCC.HCLKFreq_Value=72000000
RCC.PLLMUL=RCC_PLL_MUL9
RCC.PLLSourceVirtual=RCC_PLLSOURCE_HSE
RCC.SYSCLKFreq_VALUE=72000000
RCC.SYSCLKSource=RCC_SYSCLKSOURCE_PLLCLK
RCC.USBFreq_Value=72000000
board=custom

// file: Core/Src/main.c
/* USER CODE BEGIN Header */
/**
  ******************************************************************************
  * @file           : main.c
  * @brief          : Main program body
  ******************************************************************************
  * @attention
  *
  * Copyright (c) 2023 STMicroelectronics.
  * All rights reserved.
  *
  * This software is licensed under terms that can be found in the LICENSE file
  * in the root directory of this software component.
  * If no LICENSE file comes with this software, it is provided AS-IS.
  *
  ******************************************************************************
  */
/* USER CODE END Header */
#include "main.h"

void SystemClock_Config(void);
static void MX_GPIO_Init(void);

/* USER CODE BEGIN 0 */
//RETARDO us c++

#pragma GCC push_options   //guardar la optimizacion
#pragma GCC optimize ("O0")//sin optimizacion

//realizar primero poniendo reta*1
void delay_us_C (uint32_t reta)// reta us deseados
{
uint32_t calibra;
calibra=reta*8;  //ecuacion de calibracion  72 MHZ BLUE *8
while(calibra--);
}
#pragma GCC pop_options// recuera la optimizacion guardaa

//DELAY CON ENSAMBLADOR MODO RUTINA 72 MHZ 12
#pragma GCC push_options   //guardar la optimizacion
#pragma GCC optimize ("O0")//sin optimizacion

//21 PARA LA BLUPILL A 72MH  *12

void delay_us_ASM(uint32_t us) {
    asm volatile ("MOV R1, #12\n"
                  "MUL R1, R1, %[ciclos]\n"
            	  "MOV R0, R1\n"
                  "1:\n"
                  "SUB R0, #1\n"
                  "CMP R0, #0\n"
                  "BNE 1b\t"
                  :
                  : [ciclos] "r" (us)
                  : "memory");
}
#pragma GCC pop_options// recuera la optimizacion guardaa

//delay en ensamblador deshabilitando las interrpciones

//DELAY CON ENSAMBLADOR MODO RUTINA
#pragma GCC push_options   //guardar la optimizacion
#pragma GCC optimize ("O0")//sin optimizacion

void delay_us_ASM_IT(uint32_t us) {
    asm volatile ("CPSID i\n" \
    		      "MOV R1, #12\n"
                  "MUL R1, R1, %[ciclos]\n"
            	  "MOV R0, R1\n"
                  "1:\n"
                  "SUB R0, #1\n"
                  "CMP R0, #0\n"
                  "BNE 1b\n"
    	          "CPSIE i\t"
    		      :
                  : [ciclos] "r" (us)
                  : "memory");
}
#pragma GCC pop_options// recuera la optimizacion guardaa
/* USER CODE END 0 */

int main(void)
{

  /* MCU Configuration--------------------------------------------------------*/

  /* Reset of all peripherals, Initializes the Flash interface and the Systick. */
  HAL_Init();

  /* Configure the system clock */
  SystemClock_Config();

  /* Initialize all configured peripherals */
  MX_GPIO_Init();
  /* USER CODE BEGIN 2 */
  CoreDebug->DEMCR |= CoreDebug_DEMCR_TRCENA_Msk;
   DWT->CTRL |= DWT_CTRL_CYCCNTENA_Msk;

  /* USER CODE END 2 */

  /* Infinite loop */
  /* USER CODE BEGIN WHILE */
  while (1)
  {
	   /* DWT->CYCCNT=0;
	 	  delay_us_ASM(10);
	 	  DWT->CYCCNT=0;
	 	  delay_us_ASM(100);
	 	  	DWT->CYCCNT=0;
	 	  		  delay_us_ASM(500);
*/

	    	  salida_GPIO_Port->BSRR=salida_Pin;
	 	  	  delay_us_ASM(1);
	 	  	  salida_GPIO_Port->BSRR=salida_Pin<<16;
	 	  	  delay_us_ASM(1);

    /* USER CODE END WHILE */

  }
}

void SystemClock_Config(void)
{
  RCC_OscInitTypeDef RCC_OscInitStruct = {0};
  RCC_ClkInitTypeDef RCC_ClkInitStruct = {0};

  /** Initializes the RCC Oscillators according to the specified parameters
  * in the RCC_OscInitTypeDef structure.
  */
  RCC_OscInitStruct.OscillatorType = RCC_OSCILLATORTYPE_HSE;
  RCC_OscInitStruct.HSEState = RCC_HSE_ON;
  RCC_OscInitStruct.HSEPredivValue = RCC_HSE_PREDIV_DIV1;
  RCC_OscInitStruct.HSIState = RCC_HSI_ON;
  RCC_OscInitStruct.PLL.PLLState = RCC_PLL_ON;
  RCC_OscInitStruct.PLL.PLLSource = RCC_PLLSOURCE_HSE;
  RCC_OscInitStruct.PLL.PLLMUL = RCC_PLL_MUL9;
  if (HAL_RCC_OscConfig(&RCC_OscInitStruct) != HAL_OK)
  {
    Error_Handler();
  }

  /** Initializes the CPU, AHB and APB buses clocks
  */
  RCC_ClkInitStruct.ClockType = RCC_CLOCKTYPE_HCLK|RCC_CLOCKTYPE_SYSCLK
                              |RCC_CLOCKTYPE_PCLK1|RCC_CLOCKTYPE_PCLK2;
  RCC_ClkInitStruct.SYSCLKSource = RCC_SYSCLKSOURCE_PLLCLK;
  RCC_ClkInitStruct.AHBCLKDivider = RCC_SYSCLK_DIV1;
  RCC_ClkInitStruct.APB1CLKDivider = RCC_HCLK_DIV2;
  RCC_ClkInitStruct.APB2CLKDivider = RCC_HCLK_DIV1;

  if (HAL_RCC_ClockConfig(&RCC_ClkInitStruct, FLASH_LATENCY_2) != HAL_OK)
  {
    Error_Handler();
  }
}

static void MX_GPIO_Init(void)
{
  GPIO_InitTypeDef GPIO_InitStruct = {0};

  /* GPIO Ports Clock Enable */
  __HAL_RCC_GPIOD_CLK_ENABLE();
  __HAL_RCC_GPIOB_CLK_ENABLE();

  /*Configure GPIO pin Output Level */
  HAL_GPIO_WritePin(salida_GPIO_Port, salida_Pin, GPIO_PIN_RESET);

  /*Configure GPIO pin : salida_Pin */
  GPIO_InitStruct.Pin = salida_Pin;
  GPIO_InitStruct.Mode = GPIO_MODE_OUTPUT_PP;
  GPIO_InitStruct.Pull = GPIO_NOPULL;
  GPIO_InitStruct.Speed = GPIO_SPEED_FREQ_LOW;
  HAL_GPIO_Init(salida_GPIO_Port, &GPIO_InitStruct);

}

void Error_Handler(void)
{
  __disable_irq();
  while (1)
  {
  }
}
